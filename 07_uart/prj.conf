## CMakeLists.txt
```
# SPDX-License-Identifier: Apache-2.0

cmake_minimum_required(VERSION 3.20.0)
set(BOARD pedal)
find_package(Zephyr REQUIRED HINTS $ENV{ZEPHYR_BASE})

project(hello_world)

# target_sources(app PRIVATE src/uart_poll.c)
# target_sources(app PRIVATE src/uart_fifo.c)
target_sources(app PRIVATE src/uart_async.c)
```

## prj.conf
```kconfig
CONFIG_GPIO=y

CONFIG_CONSOLE=n
CONFIG_UART_CONSOLE=n
```

## boards/pedal.overlay
```dts
&usart1 {
    current-speed = <9600>;
};
```

## src/main.c
```c
/*
 * Copyright (c) 2012-2014 Wind River Systems, Inc.
 *
 * SPDX-License-Identifier: Apache-2.0
 */

#include <zephyr/device.h>
#include <zephyr/drivers/uart.h>
#include <zephyr/kernel.h>
#include <zephyr/sys/printk.h>

/** 
* *这个的操作不是通过API操作，而是直接操作设备，这个和别的区别就是没有封装成DT（比如LED_GPIO）
* *操作似乎比较底层，但是又不是特别底层
*/

int main(void)
{
    int err;
    // const struct device *uart = DEVICE_DT_GET(DT_PATH(soc, serial_40013800));
    const struct device *uart = DEVICE_DT_GET(DT_NODELABEL(usart1));
    
    err = device_is_ready(uart);
    if (err < 0) {
        return 0;
    }

    printk("this function is invalid, so not show this messge");
    
    while (1) {
        uart_poll_out(uart, 'c');
        k_msleep(1000);
    }

    return 0;
}
// west build -p always hello_world
```

## src/uart_poll.c
```c
/*
 * Copyright (c) 2012-2014 Wind River Systems, Inc.
 *
 * SPDX-License-Identifier: Apache-2.0
 */

#include <zephyr/device.h>
#include <zephyr/drivers/uart.h>
#include <zephyr/kernel.h>
#include <zephyr/sys/printk.h>

/* 
    输入什么就返回什么
 */

/** 
* *这个的操作不是通过API操作，而是直接操作设备，这个和别的区别就是没有封装成DT（比如LED_GPIO）
* *操作似乎比较底层，但是又不是特别底层，是最基础的API实现的
*/

int main(void)
{
    int err;
    char ret;
    // const struct device *uart = DEVICE_DT_GET(DT_PATH(soc, serial_40013800));
    const struct device *uart_dev = DEVICE_DT_GET(DT_NODELABEL(usart1));

    // 检查设备
    err = device_is_ready(uart_dev);
    if (err < 0) {
        return -1;
    }

    while (1) {
        // POLL
        err = uart_poll_in(uart_dev, &ret);
        if (err >= 0) {
            uart_poll_out(uart_dev, ret);
        }
    }

    return 0;
}
// west build -p always hello_world
```
