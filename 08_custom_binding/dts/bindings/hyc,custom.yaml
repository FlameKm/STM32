## 08_custom_binding/dts/bindings/hyc,custom.yaml
```yaml
description: hyc's custom test.

compatible: "hyc,custom"
properties:
  pwms:
    required: true
    type: phandle-array
    description: pwms

  min-pulse:
    required: false
    type: int
    description: min-pulse

  max-pulse:
    required: false
    type: int
    description: max-pulse
```

## boards/Kconfig.board
```kconfig
# STM32F103RCT6 Mini board configuration

# Copyright (c) 2020 WuhanStudio
# SPDX-License-Identifier: Apache-2.0

config BOARD_PEDAL
	bool "PEDAL Board"
	depends on SOC_STM32F103XB
```
